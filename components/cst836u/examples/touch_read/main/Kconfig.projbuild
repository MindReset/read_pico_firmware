## components/cst836u/examples/touch_read/main/Kconfig.projbuild
```kconfig
menu "CST836U touch_read"

    config CST836U_EXAMPLE_I2C_PORT
        int "I2C port"
        default 0
        range 0 1

    config CST836U_EXAMPLE_SDA
        int "SDA GPIO"
        default 39

    config CST836U_EXAMPLE_SCL
        int "SCL GPIO"
        default 40

    config CST836U_EXAMPLE_INT
        int "INT GPIO (active low)"
        default 43

    config CST836U_EXAMPLE_RST
        int "RST GPIO (-1 = skip sleep/wake demo)"
        default -1
        range -1 48

endmenu
```

## components/fca9555/Kconfig
```kconfig
menu "FCA9555 I/O Expander"

    config FCA9555_I2C_TIMEOUT_MS
        int "I2C transfer timeout (ms)"
        default 100
        range 10 1000
        help
            Fail fast on a missing chip. 100 ms is enough for an 8-byte
            sequential read at 400 kHz.
            芯片无应答时尽快失败。400 kHz 下连读 8 字节，100 ms 足够。

endmenu
```

## components/fca9555/examples/read_ports/main/Kconfig.projbuild
```kconfig
menu "FCA9555 read_ports"

    config FCA9555_EXAMPLE_I2C_PORT
        int "I2C port"
        default 0
        range 0 1

    config FCA9555_EXAMPLE_SDA
        int "SDA GPIO"
        default 39

    config FCA9555_EXAMPLE_SCL
        int "SCL GPIO"
        default 40

    config FCA9555_EXAMPLE_ADDR
        hex "7-bit I2C address (A2=1 A1=0 A0=0 → 0x24)"
        default 0x24

    config FCA9555_EXAMPLE_INT
        int "INT# GPIO (-1 = skip)"
        default 41
        range -1 48

endmenu
```

## components/read_pico/Kconfig
```kconfig
menu "Read Pico board configuration"

config READ_PICO_I2C_PORT
    int "I2C controller"
    default 0
    range 0 1

config READ_PICO_I2C_SCL_GPIO
    int "I2C SCL GPIO"
    default 40
    range 0 48

config READ_PICO_I2C_SDA_GPIO
    int "I2C SDA GPIO"
    default 39
    range 0 48

config READ_PICO_I2C_FREQ_HZ
    int "I2C frequency (Hz)"
    default 400000
    range 10000 400000

config READ_PICO_IOE_INT_GPIO
    int "FCA9555 interrupt GPIO"
    default 41
    range 0 48

config READ_PICO_TP_INT_GPIO
    int "CST836U interrupt GPIO"
    default 43
    range 0 48

endmenu
```

## components/sc7a20h/examples/pickup_wake/main/Kconfig.projbuild
```kconfig
menu "SC7A20H pickup_wake"

    config SC7A20H_EXAMPLE_I2C_PORT
        int "I2C port"
        default 0
        range 0 1

    config SC7A20H_EXAMPLE_SDA
        int "SDA GPIO"
        default 6

    config SC7A20H_EXAMPLE_SCL
        int "SCL GPIO"
        default 7

    config SC7A20H_EXAMPLE_INT1
        int "INT1 GPIO"
        default 1

endmenu
```
